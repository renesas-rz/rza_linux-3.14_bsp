## patches-buildroot/buildroot-2014.05/rskrza1_min_defconfig
```kconfig
BR2_arm=y
BR2_cortex_a9=y
BR2_ARM_EABIHF=y
BR2_DEFCONFIG="$(CONFIG_DIR)/defconfig"
BR2_TOOLCHAIN_EXTERNAL=y
BR2_TARGET_GENERIC_GETTY_PORT="ttySC2"
BR2_ROOTFS_OVERLAY="$(BASE_DIR)/rootfs_overlay"
```

## patches-buildroot/buildroot-2016.08/rskrza1_defconfig
```kconfig
BR2_arm=y
BR2_cortex_a9=y
BR2_ARM_ENABLE_NEON=y
BR2_ARM_ENABLE_VFP=y
BR2_ARM_FPU_VFPV3=y
BR2_TOOLCHAIN_EXTERNAL=y
BR2_TARGET_GENERIC_GETTY_PORT="ttySC2"
BR2_ROOTFS_OVERLAY="$(BASE_DIR)/rootfs_overlay"
BR2_PACKAGE_ALSA_UTILS=y
BR2_PACKAGE_ALSA_UTILS_AMIXER=y
BR2_PACKAGE_ALSA_UTILS_APLAY=y
BR2_PACKAGE_MPG123=y
BR2_PACKAGE_MTD=y
BR2_PACKAGE_FBV=y
# BR2_PACKAGE_FBV_PNG is not set
# BR2_PACKAGE_FBV_GIF is not set
BR2_PACKAGE_JPEG=y
BR2_PACKAGE_JPEG_TURBO=y
BR2_PACKAGE_TSLIB=y
BR2_TARGET_ROOTFS_SQUASHFS=y
```

## patches-buildroot/buildroot-2016.08/rskrza1_min_defconfig
```kconfig
BR2_arm=y
BR2_cortex_a9=y
BR2_ARM_ENABLE_NEON=y
BR2_ARM_ENABLE_VFP=y
BR2_ARM_FPU_VFPV3=y
BR2_TOOLCHAIN_EXTERNAL=y
BR2_TARGET_GENERIC_GETTY_PORT="ttySC2"
BR2_ROOTFS_OVERLAY="$(BASE_DIR)/rootfs_overlay"
```

## patches-buildroot/rskrza1_defconfig
```kconfig
BR2_arm=y
BR2_cortex_a9=y
BR2_ARM_EABIHF=y
BR2_DEFCONFIG="$(CONFIG_DIR)/defconfig"
BR2_TOOLCHAIN_EXTERNAL=y
BR2_TOOLCHAIN_EXTERNAL_PREINSTALLED=y
BR2_TOOLCHAIN_EXTERNAL_PATH="/home/renesas/rza1/tools/gcc-linaro-arm-linux-gnueabihf-4.8-2014.02_linux"
BR2_TARGET_GENERIC_GETTY_PORT="ttySC2"
BR2_ROOTFS_OVERLAY="$(BASE_DIR)/rootfs_overlay"
BR2_PACKAGE_ALSA_UTILS=y
BR2_PACKAGE_ALSA_UTILS_AMIXER=y
BR2_PACKAGE_ALSA_UTILS_APLAY=y
BR2_PACKAGE_MPG123=y
BR2_PACKAGE_MTD=y
BR2_PACKAGE_JPEG=y
BR2_PACKAGE_JPEG_TURBO=y
BR2_TARGET_ROOTFS_SQUASHFS=y
```
